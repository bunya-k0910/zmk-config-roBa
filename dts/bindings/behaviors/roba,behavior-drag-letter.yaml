## dts/bindings/behaviors/roba,behavior-drag-letter.yaml
```yaml
description: Gesture letter branch for standard hold-tap
compatible: "roba,behavior-drag-letter"
include: one_param.yaml
```

## dts/bindings/behaviors/roba,behavior-drag-mode.yaml
```yaml
description: Gesture mode branch for standard hold-tap
compatible: "roba,behavior-drag-mode"
include: one_param.yaml
```

## dts/bindings/behaviors/roba,behavior-drag-tap.yaml
```yaml
description: Immediate gesture mode with text tap only when no gesture was used
compatible: "roba,behavior-drag-tap"
include: two_param.yaml
```

## dts/bindings/input_processors/roba,input-processor-drag.yaml
```yaml
description: Stroke recognition with native keyboard shortcuts while a mode key is held
compatible: "roba,input-processor-drag"
include: ip_zero_param.yaml
```

## dts/bindings/input_processors/roba,input-processor-gesture.yaml
```yaml
description: One-shot Mission Control and idle-rearmed desktop gestures
compatible: "roba,input-processor-gesture"
include: ip_zero_param.yaml
properties:
  layer:
    type: int
    required: true
  bindings:
    type: phandle-array
    required: true
  threshold:
    type: int
    required: true
  idle-ms:
    type: int
    required: true
  tap-ms:
    type: int
    required: true
```
